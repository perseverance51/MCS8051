#include <reg51.h>
#include <intrins.h>
#include<ABSACC.H>
#define uchar unsigned char
#define  data_OUT  XBYTE[0x7FFF]
char code dat[]= {
    0x80,0x83,0x86,0x89,0x8D,0x90,0x93,0x96,0x99,0x9C,0x9F,0xA2,0xA5,0xA8,0xAB,0xAE,
    0xB1,0xB4,0xB7,0xBA,0xBC,0xBF,0xC2,0xC5,0xC7,0xCA,0xCC,0xCF,0xD1,0xD4,0xD6,0xD8,
    0xDA,0xDD,0xDF,0xE1,0xE3,0xE5,0xE7,0xE9,0xEA,0xEC,0xEE,0xEF,0xF1,0xF2,0xF4,0xF5,
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    0x51,0x55,0x57,0x5A,0x5D,0x60,0x63,0x66,0x69,0x6C,0x6F,0x72,0x76,0x79,0x7C,0x7E
};

bit flag=0;

void delay(unsigned  int N)
{
    int i;
    for(i=0; i<N; i++);
}

void conversion_once_0832(unsigned char out_data)
{
    data_OUT=out_data; //输出数据
    delay(10);         //延时等待转换
}
uchar  keyscan()
{
    uchar key;
    if(P1!=0xff)
    {
        delay(61);
        key=P1;
        if(key!=0xff)
            flag=~flag;

    }
    return(key);
}

void triangle()
{
    uchar k;
    for(k=0; k<255; k++)
        conversion_once_0832(k);
    for(; k>0; k--)
        conversion_once_0832(k);
}
void square()
{
    conversion_once_0832(0xff);
    delay(1000);
    conversion_once_0832(0x00);
    delay(1000);

}
void juchibo()
{
    uchar j;
    for(j=0; j<255; j++)
        conversion_once_0832(j);
}
void sin()
{
    uchar i;
    for(i=0; i<255; i++)
    {
        conversion_once_0832(dat[i]);
    }
}
void main()
{
    uchar temp;
    while(1)
    {
        temp=keyscan();
        switch(temp)
        {
        case 0xfe:
            do {
                triangle();
            } while(keyscan()&&(flag==1));
            break;
        case 0xfd:
            do {
                square();
            } while(keyscan()&&(flag==1));
            break;
        case 0xfb:
            do {
                juchibo();
            } while(keyscan()&&(flag==1));
            break;
        case 0xf7:
            do {
                sin();
            } while(keyscan()&&(flag==1));
            break;
        default:
            break;
        }
    }

}