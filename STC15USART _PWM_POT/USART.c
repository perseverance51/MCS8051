/*----------------------------------------------------------   
 * 项目名称:

     串口通信驱动程序

 * 功能描述:

     1、串口初始化  
	 2、查询法接收一个字节 
	 3、串口发送一个字节
	 4、串口发送一个字符串 
	 5、串口中断方式接收一个字符

 * 配置说明:
     MCU:             STC15W408AS
     开发板:       	  STC15W408AS开发板
     晶振:      	  内部时钟：11.0592MHz
     扩展模块:  	  -
     软件:            Keil.C51.V9.01

 * 备注:
     - 将开发板的串口与电脑串口连接
 * 注意：STC15W408AS只有定时器0和定时器2，没有定时器1，所以只能使用定时器2作为波特率发生器
----------------------------------------------------------*/   

#include "USART.h"

//#define		BaudRate1		9600L
//#define	Timer1_Reload	(65536UL -(MAIN_Fosc / 4 / BaudRate1))		//Timer 1 重装值， 对应300KHZ
unsigned char *pchar;				//定义一个全局指针
bit busy;
//----------------------------------------------------------   
//  函数名称：void IniSerialPort(void)   
//  函数功能：串口初始化   
//----------------------------------------------------------   
void InitSerialPort(void)
{ 
		SCON = 0x50;			//8位数据，可变波特率
		AUXR |= 0x01;			
		AUXR |= 0x04;			//定时器时钟为Fosc，1T模式
		T2L = 0x5F;		//设置定时2初始值9600bps@外部晶振16MHz
	  T2H = 0xFE;		//设置定时初始值
		AUXR |= 0x10;			//启动定时器	

//	T2L= (65536 - (FOSC/4/BAUD)); //设置波特率重装值
//	T2H = (65536 - (FOSC/4/BAUD))>>8;
	ES = 1; //使能串口中断
//	ET0 = 1;		//禁止定时器1中断
	
    	REN=1;      			//串口为工作方式1，允许接收数据
    	SM0=0;					//SM0 SM1串口工作方式选择，01：8位异步收发，波特率由定时器决定
    	SM1=1;
}
//----------------------------------------------------------   
//  函数名称：unsigned char ReceiveByte(void)
//  函数功能：查询法接收一个字节   
//----------------------------------------------------------   
unsigned char ReceiveByte(void)
{
     unsigned char rbyte;
     while(!RI); 					//查询接收标志位，是否有数据到达缓冲区
     RI=0; 							//清零接收标志位
     rbyte=SBUF; 					//从缓冲区读取数据
     return rbyte;
}
//----------------------------------------------------------   
//  函数名称：putchar(unsigned char c)
//  函数功能：串口发送一个字节
//----------------------------------------------------------   

 char putchar(unsigned char c)
{
	     SBUF = c; 					//发送数据
     while(!TI); 					//等待发送完成
     TI=0; 							//清零发送标志位;
	return c;
}
//----------------------------------------------------------   
//  函数名称：void SendString(unsigned char *pstr)
//  函数功能：串口发送一个字符串
//----------------------------------------------------------   
//void SendString(unsigned char *pstr)
//{
//     while(*pstr!='\0') 			//字符串是否发完
//     {
//         SendByte(*pstr);			//发送字符串数据
//         pstr++; 					//指向下一个字符
//     } 
//}
//----------------------------------------------------------   
//  函数名称：void SerialPortInte(void)
//  函数功能：串口中断方式接收一个字符
//----------------------------------------------------------   
void SerialPortInte(void) interrupt 4 using 1
{ 
	if(RI)
	{
     RI=0;						    //清零接收标志位
     *pchar=SBUF;					//读取缓冲区的数据
	}
	if(TI)
	{
		TI=0;//清除TI位
		busy = 0;//清忙标志

	}
}
/**********************************THE END**********************************/ 

 

