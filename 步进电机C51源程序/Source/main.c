//-----------------------------------------------------------------
//  名称:步进电机(28BYJ-48)程序
//-----------------------------------------------------------------

//---1~9档的转速------------------------------------------------
//DEE4	定时时间	8.476ms	,		转速	1.73r/min
//E1EC	定时时间	7.7ms	,			转速	1.90r/min
//E5D4	定时时间	6.7ms,			转速	2.19r/min
//E9BC	定时时间	5.7ms,			转速	2.57r/min
//EDA4	定时时间	4.7ms,			转速	3.12r/min
//F18C	定时时间	3.7ms,			转速	3.96r/min
//F574	定时时间	2.7ms,			转速	5.43r/min
//F95C	定时时间	1.7ms,			转速	8.62r/min
//FC18	定时时间	1ms	 ,			转速	14.65r/min
//-----------------------------------------------------------------
//转一圈需要节拍数：360/(5.625/64) = 4096 个节拍
//转速r/min = (60*1000) / (4096 * 定时时间)
//-----------------------------------------------------------------

#include "Key.h"

//0~9 的共阳数码管段码，最后一个是黑屏
const uchar SEG_CODE[] = {0xC0,0xF9,0xA4,0xB0,0x99,0x92,0x82,0xF8,0x80,0x90,0xFF};

//输出励磁序列的频率参数{TH1,TL1}
const uchar Timer[9][2]={{0xDE,0xE4},{0xE1,0xEC},{0xE5,0xD4},{0xE9,0xBC},  //8.476 ~ 1ms
							    {0xEd,0xA4},{0xF1,0x8C},{0xF5,0x74},{0xF9,0x5C},{0xFC,0x18}};

//步进电机正转的励磁序列
const uchar FFW[] = {0x1F,0x3F,0x2F,0x6F,0x4F,0xCF,0x8F,0x9F}; //DCBAXXXX

//步进电机反转的励磁序列
const uchar REV[] = {0x9F,0x8F,0xCF,0x4F,0x6F,0x2F,0x3F,0x1F}; //DCBAXXXX

//枚举变量--正反转标志
typedef enum
	{FwdRun, RevRun} RunFlag;								
RunFlag flag1 = FwdRun;

uchar speed = 1;

//函数声明
void T0_Init();					//定时器0初始化函数声明
void T1_Init();					//定时器1初始化函数声明
void KeyService();			//按键服务函数声明
void delay_ms(uint t);	//毫秒延时函数声明
	
//-----------------------------------------------------------------
// 主程序
//-----------------------------------------------------------------
void main()
{	
	T0_Init();					//定时器0初始化
	T1_Init();					//定时器1初始化
	FWD_LED = 0;				//正转指示灯亮，默认初始化是正转
	
	delay_ms(500);			//延时500ms，待各个模块上电稳定
	EA = 1;							//开启中断
	while(1)
	{	
		KeyService();		//按键服务程序
	}
}	

//-----------------------------------------------------------------
// Timer0 初始化，模式1，允许中断，1ms定时
// Timer0 用于按键扫描
//-----------------------------------------------------------------
void T0_Init()
{
	TMOD &= 0xF0;
	TMOD |= 0x01;										//T0工作于模式1,16位定时器
	TH0 = (65536 - 1000) >> 8;			//1ms定时
	TL0 = (65536 - 1000) & 0xFF;
	ET0 = 1;												//允许T0中断
	TR0 = 1;												//启动T0
}

//-----------------------------------------------------------------
// Timer1 初始化，模式1，允许中断
// Timer1 用于改变步进电机转速
//-----------------------------------------------------------------
void T1_Init()
{
	TMOD &= 0x0F;
	TMOD |= 0x10;							//定时器1工作于模式1,16位定时器
	TH1 = Timer[speed][0];
	TL1 = Timer[speed][1];		//定时器1，定时用于步进电机转速控制
	ET1 = 1;									//允许T1中断
	PT1 = 1;									//定时器1优先级高
	TR1 = 0;									//关闭定时器1
}

//-----------------------------------------------------------------
// Timer0 中断服务程序
//-----------------------------------------------------------------
void InterruptTime0() interrupt 1
{
	TH0 = (65536 - 1000) >> 8;		//1ms
	TL0 = (65536 - 1000) & 0xFF;
	KeyScan();										//按键扫描
}


//-----------------------------------------------------------------
// Timer1 中断服务程序
//-----------------------------------------------------------------
void InterruptTime1() interrupt 3
{
	 static volatile unsigned char step1 = 0;							
	 static volatile unsigned char step2 = 0;
	if(!speed) speed = 1;
	TH1 = Timer[speed - 1][0];			//根据不同的转速档位，给定时器1赋定时器值
	TL1 = Timer[speed - 1][1];			
	
	//按照定时器1的频率循环发送正转励磁序列的脉冲给步进电机，使其不停地转动
	if(flag1 == FwdRun)//正转
	{
		MotorDriver = FFW[step1++];		
		step1 %= 8; 
	}
	
	 //按照定时器1的频率循环发送反转励磁序列的脉冲给步进电机，使其不停地转动
	else if(flag1 == RevRun)       
	{
		MotorDriver = REV[step2++];
		step2  %=8; 
	}
}

//-----------------------------------------------------------------
// 按键服务程序
//-----------------------------------------------------------------
void KeyService()
{
	switch (KeyCode)
	{
		case 1:	flag1 = FwdRun;										//正转
						SpeedShow = SEG_CODE[speed];
						FWD_LED = 0;	REV_LED = 1;				//正转指示灯亮
						if(TR1 == 0) TR1 = 1;
						KeyCode = 0;
						break;							
		case 2:	flag1 = RevRun;										//反转
						SpeedShow = SEG_CODE[speed];
						FWD_LED = 1;	REV_LED = 0;				//反转指示灯亮
						if(TR1 == 0) TR1 = 1;
						KeyCode = 0;
						break;
		case 3:	speed++;										//速度加
						if(speed >= 9) speed = 9;										
						SpeedShow = SEG_CODE[speed];
						if(TR1 == 0) TR1 = 1;
						KeyCode = 0;
						break;
		case 4:	speed--;												//速度减
						if(speed <= 1 ) speed = 1;						
						SpeedShow = SEG_CODE[speed];	
						if(TR1 == 0) TR1 = 1;	
						KeyCode = 0;
						break;
		case 5:	TR1 = 0;													//停止
						SpeedShow = 0xFF;
						MotorDriver = 0x00;
						KeyCode = 0;
						break;	
		default: ;
	}
}

//-----------------------------------------------------------------
//函数名称：	void delay_ms(uint t)
//函数功能:		延时ms程序(粗略)
//调用子函数: 无
//输入参数: 	t
//返回值:			无
//-----------------------------------------------------------------
void delay_ms(uint t)
{
	uchar i; while(t--) for(i = 0; i < 125; i++);
}
