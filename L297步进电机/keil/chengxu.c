/********************************************************************
 L297驱动步进电机
*********************************************************************/

#include<reg52.h> 
#define uchar unsigned char
#define uint unsigned int

/********************************************************
 						控制位定义
********************************************************/

sbit shi_neng=P2^0;  //	使能控制位
sbit fang_shi=P2^1;  //	工作方式控制位，半步、全步方式 选择端。此引脚输入高电平时为半步方式(四相八拍)，
//低电平时为全步方式。如选择全步方式时变换器在奇数状态，会得到单相工作方式(单四拍)。
sbit fang_xiang=P2^2;//	旋转方向控制位
sbit mai_chong=P2^3; // 脉冲控制位

/********************************************************
 						延时函数
********************************************************/
void delay(uint i)//延时函数
{
	uchar j,k;
	for(j=0;j<i;j++)
	for(k=0;k<250;k++);
}

/********************************************************
 						延时函数
********************************************************/

main()
{
	shi_neng=1;  //	使能控制位
	fang_shi=0;  //	工作方式控制位,高电平时为半步方式(四相八拍)，低电平时为全步方式
	fang_xiang=1;//	旋转方向控制位
	mai_chong=1; // 脉冲控制位
	
	while(1)
	{
		mai_chong=~mai_chong; //输出时钟脉冲
		delay(15);			  //延时  (括号内数值越小，电机转动速度越快)
	//	mai_chong=~mai_chong; //输出时钟脉冲
	}
}